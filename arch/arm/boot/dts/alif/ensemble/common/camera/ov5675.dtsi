// SPDX-License-Identifier: GPL-2.0
/*
 * OV5675 on the Ensemble selfie connector.
 * Included by serial_camera.dtsi when
 * ENSEMBLE_CAMERA_SENSOR_DTSI is "camera/ov5675.dtsi".
 *
 * The source endpoint label sensor_csi2_ep is the same in every sensor
 * fragment. CSI receives it as &csi2_in.
 */

&selfie_i2c {
	/* 0x10 is the compact module; legacy modules use 0x36. */
	selfie_camera: camera@10 {
		compatible = "ovti,ov5675";
		reg = <0x10>;
		clocks = <&psclks ENSEMBLE_EXT_CLK>;
		pinctrl-0 = <&pinctrl_csi_cam>;
		pinctrl-names = "default";
		reset-gpios = <&port15 4 GPIO_ACTIVE_LOW>;
		avdd-supply = <&reg_2p7v>;
		dvdd-supply = <&reg_1p2v>;
		dovdd-supply = <&reg_1p8v>;
		status = "okay";

		port {
			sensor_csi2_ep: endpoint {
				bus-type = <MEDIA_BUS_TYPE_CSI2_DPHY>;
				data-lanes = <1 2>;
				remote-endpoint = <&csi2_in>;
				link-frequencies = /bits/ 64 <450000000>;
			};
		};
	};
};
